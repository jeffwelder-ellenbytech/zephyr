## CMakeLists.txt
```
#
# SPDX-FileCopyrightText: Copyright The Zephyr Project Contributors
# SPDX-FileCopyrightText: Copyright (c) 2026 Jeff Welder
#
# SPDX-License-Identifier: Apache-2.0
#

cmake_minimum_required(VERSION 3.20.0)
find_package(Zephyr REQUIRED HINTS $ENV{ZEPHYR_BASE})
project(transport_bt_client_gatt_stub)

target_sources(app PRIVATE
  src/main.c
  src/gatt_stub.c
)

target_include_directories(app PRIVATE src)
```

## Kconfig
```
#
# SPDX-FileCopyrightText: Copyright The Zephyr Project Contributors
# SPDX-FileCopyrightText: Copyright (c) 2026 Jeff Welder
#
# SPDX-License-Identifier: Apache-2.0
#

# The transport under test is a GATT client, and this suite supplies the GATT client API
# itself so that it can answer as an uncooperative peer would. CONFIG_BT_HCI is therefore
# never set: subsys/bluetooth/CMakeLists.txt only adds the host under it, so the host is
# not compiled and src/gatt_stub.c holds the only definitions of those entry points. The
# symbols the transport needs are forced here because they are all inside "if BT" and so
# cannot be reached from prj.conf with the Bluetooth stack left out. Same technique, and
# for the same reason, as tests/bluetooth/audio.

config BT_CONN
	bool
	default y

config BT_CENTRAL
	bool
	default y

config BT_GATT_CLIENT
	bool
	default y

config BT_MAX_CONN
	int
	default 2

config BT_MAX_PAIRED
	int
	default 1

config BT_ATT_TX_COUNT
	int
	default 3

config BT_L2CAP_TX_MTU
	int
	default 247

config MCUMGR_TRANSPORT_BT_CLIENT
	bool
	default y

source "Kconfig.zephyr"
```

## prj.conf
```kconfig
#
# SPDX-FileCopyrightText: Copyright The Zephyr Project Contributors
# SPDX-FileCopyrightText: Copyright (c) 2026 Jeff Welder
#
# SPDX-License-Identifier: Apache-2.0
#

CONFIG_ZTEST=y
CONFIG_ZTEST_STACK_SIZE=4096

CONFIG_NET_BUF=y
CONFIG_ZCBOR=y
CONFIG_CRC=y
CONFIG_BASE64=y
CONFIG_MCUMGR=y
CONFIG_SMP_CLIENT=y

# Extend the system work queue stack, which is where the stub answers from.
CONFIG_SYSTEM_WORKQUEUE_STACK_SIZE=2304

# Lets the test observe the buffer pool directly, which is how it proves that the
# transmit path releases the packet it was handed even when it refuses to send it.
CONFIG_NET_BUF_POOL_USAGE=y
CONFIG_MCUMGR_TRANSPORT_NETBUF_AVAILABLE=y

# A test may leave a command outstanding, and its buffer only comes back when the SMP
# client gives up on it, so the pool needs a little more headroom than the default.
CONFIG_MCUMGR_TRANSPORT_NETBUF_COUNT=6
```

## src/gatt_stub.c
```c
/*
 * SPDX-FileCopyrightText: Copyright The Zephyr Project Contributors
 * SPDX-FileCopyrightText: Copyright (c) 2026 Jeff Welder
 *
 * SPDX-License-Identifier: Apache-2.0
 */

/*
 * A scripted stand-in for the Bluetooth host's GATT client API.
 *
 * CONFIG_BT_HCI is not set, so subsys/bluetooth/CMakeLists.txt never adds the host
 * directory and these are the only definitions of the GATT client entry points in the
 * image. The same technique, and for the same reason, as tests/bluetooth/audio.
 *
 * Every entry point below reproduces the control flow of its counterpart in
 * subsys/bluetooth/host/gatt.c, because the transport under test is built almost entirely
 * out of claims about exactly when the host calls back:
 *
 *   bt_gatt_subscribe()   issues the client characteristic configuration write and only
 *                         then links the node, so a failed write leaves nothing linked.
 *   bt_gatt_unsubscribe() issues its own write, unlinks the node and returns success
 *                         WITHOUT a synchronous notify(NULL) - that arrives later, from
 *                         the write response.
 *   gatt_write_ccc_rsp()  runs the subscribe callback, then removes the node and reports
 *                         it through notify(NULL); on an error it first looks the
 *                         connection's subscription list up and returns silently if the
 *                         node has already left it.
 *   disconnect            fails every pending ATT request with -ECONNRESET first (which
 *                         is what ends a discovery and a descriptor write), then sweeps
 *                         the volatile subscriptions with notify(NULL), and only then
 *                         runs the application's bt_conn_cb.disconnected callbacks.
 *
 * Discovery results and descriptor write responses are delivered from a work queue by
 * default, never from inside the call that asked for them, because the whole generation
 * and ownership machinery in the transport exists to survive callbacks that arrive after
 * the caller has stopped waiting for them.
 */

#include <errno.h>
#include <string.h>

#include <zephyr/bluetooth/att.h>
#include <zephyr/bluetooth/gatt.h>
#include <zephyr/bluetooth/hci_types.h>
#include <zephyr/bluetooth/uuid.h>
#include <zephyr/kernel.h>
#include <zephyr/mgmt/mcumgr/transport/smp_bt.h>
#include <zephyr/sys/iterable_sections.h>
#include <zephyr/sys/util.h>

#include "gatt_stub.h"

struct gatt_stub_peer gatt_stub_peer;
struct gatt_stub_log gatt_stub_log;
struct gatt_stub_faults gatt_stub_faults;

static const struct bt_uuid_128 stub_svc_uuid = BT_UUID_INIT_128(SMP_BT_SVC_UUID_VAL);
static const struct bt_uuid_128 stub_chr_uuid = BT_UUID_INIT_128(SMP_BT_CHR_UUID_VAL);

static uint16_t stub_mtu;

/* The host's per-connection subscription list, which never holds more than the one node
 * this transport owns.
 */
static struct bt_gatt_subscribe_params *sub_node;
static struct bt_conn *sub_conn;

/* The one outstanding ATT request of each kind, as the host's request queue would hold
 * it. Both are answered from a work queue so that no callback ever runs on the thread
 * that asked for it.
 */
static struct {
	struct bt_conn *conn;
	struct bt_gatt_discover_params *params;
	bool active;
} discover_req;

static struct {
	struct bt_conn *conn;
	struct bt_gatt_subscribe_params *params;
	uint8_t att_err;
	bool active;
} ccc_req;

static struct {
	struct bt_conn *conn;
	bt_gatt_complete_func_t func;
	void *user_data;
} tx_done[GATT_STUB_MAX_FRAGS];
static int tx_done_count;

static struct k_work_delayable discover_work;
static struct k_work_delayable ccc_work;

static void discover_deliver(void);
static void ccc_deliver(void);

static void discover_work_handler(struct k_work *work)
{
	ARG_UNUSED(work);

	discover_deliver();
}

static void ccc_work_handler(struct k_work *work)
{
	ARG_UNUSED(work);

	ccc_deliver();
}

void gatt_stub_reset(void)
{
	struct k_work_sync sync;
	static bool work_inited;

	if (!work_inited) {
		k_work_init_delayable(&discover_work, discover_work_handler);
		k_work_init_delayable(&ccc_work, ccc_work_handler);
		work_inited = true;
	}

	(void)k_work_cancel_delayable_sync(&discover_work, &sync);
	(void)k_work_cancel_delayable_sync(&ccc_work, &sync);

	gatt_stub_peer = (struct gatt_stub_peer){
		.svc_handle = 0x0010,
		.svc_end_handle = 0x0013,
		.chrc_handle = 0x0011,
		.value_handle = 0x0012,
		.ccc_handle = 0x0013,
		.properties = BT_GATT_CHRC_WRITE_WITHOUT_RESP | BT_GATT_CHRC_NOTIFY,
		.has_svc = true,
		.has_chrc = true,
		.has_ccc = true,
	};

	memset(&gatt_stub_log, 0, sizeof(gatt_stub_log));
	memset(&gatt_stub_faults, 0, sizeof(gatt_stub_faults));
	/* Every leg of every procedure is answered from the work queue, one tick of
	 * latency away, unless a test asks for something else.
	 */
	gatt_stub_faults.rsp_delay_ms = 5;

	memset(&discover_req, 0, sizeof(discover_req));
	memset(&ccc_req, 0, sizeof(ccc_req));
	tx_done_count = 0;
	sub_node = NULL;
	sub_conn = NULL;
	stub_mtu = 247;
}

void gatt_stub_set_mtu(uint16_t mtu)
{
	stub_mtu = mtu;
}

bool gatt_stub_is_subscribed(void)
{
	return sub_node != NULL;
}

const struct bt_gatt_subscribe_params *gatt_stub_sub_params(void)
{
	return sub_node;
}

bool gatt_stub_ccc_response_pending(void)
{
	return ccc_req.active;
}

/* --- Connection references ------------------------------------------------------- */

struct bt_conn *bt_conn_ref(struct bt_conn *conn)
{
	conn->ref++;

	return conn;
}

void bt_conn_unref(struct bt_conn *conn)
{
	conn->ref--;
}

/* --- ATT_MTU --------------------------------------------------------------------- */

uint16_t bt_gatt_get_mtu(struct bt_conn *conn)
{
	ARG_UNUSED(conn);

	return stub_mtu;
}

/* --- Discovery ------------------------------------------------------------------- */

/*
 * One leg of a discovery. The service and characteristic legs hand back the declaration
 * attribute rather than the value attribute, exactly as gatt_find_type_rsp() and
 * parse_characteristic() do, which is what makes the transport's "read the value handle
 * out of the declaration" requirement testable.
 */
static void discover_deliver(void)
{
	static struct bt_gatt_service_val svc;
	static struct bt_gatt_chrc chrc;
	struct bt_gatt_discover_params *params = discover_req.params;
	struct bt_conn *conn = discover_req.conn;
	struct bt_gatt_attr attr;

	if (!discover_req.active) {
		return;
	}

	discover_req.active = false;
	memset(&attr, 0, sizeof(attr));

	switch (params->type) {
	case BT_GATT_DISCOVER_PRIMARY:
		if (!gatt_stub_peer.has_svc) {
			break;
		}

		svc.uuid = &stub_svc_uuid.uuid;
		svc.end_handle = gatt_stub_peer.svc_end_handle;
		attr.uuid = BT_UUID_GATT_PRIMARY;
		attr.handle = gatt_stub_peer.svc_handle;
		attr.user_data = &svc;
		(void)params->func(conn, &attr, params);
		return;
	case BT_GATT_DISCOVER_CHARACTERISTIC:
		if (!gatt_stub_peer.has_chrc) {
			break;
		}

		chrc.uuid = &stub_chr_uuid.uuid;
		chrc.value_handle = gatt_stub_peer.value_handle;
		chrc.properties = gatt_stub_peer.properties;
		attr.uuid = BT_UUID_GATT_CHRC;
		attr.handle = gatt_stub_peer.chrc_handle;
		attr.user_data = &chrc;
		(void)params->func(conn, &attr, params);
		return;
	case BT_GATT_DISCOVER_DESCRIPTOR:
		if (!gatt_stub_peer.has_ccc) {
			break;
		}

		attr.uuid = BT_UUID_GATT_CCC;
		attr.handle = gatt_stub_peer.ccc_handle;
		(void)params->func(conn, &attr, params);
		return;
	default:
		break;
	}

	/* Nothing matched, which every discovery response handler in the host reports
	 * as a terminal callback with a NULL attribute.
	 */
	(void)params->func(conn, NULL, params);
}

int bt_gatt_discover(struct bt_conn *conn, struct bt_gatt_discover_params *params)
{
	if (gatt_stub_faults.discover_err != 0 &&
	    gatt_stub_log.discover_calls >= gatt_stub_faults.discover_err_after) {
		gatt_stub_log.discover_calls++;
		return gatt_stub_faults.discover_err;
	}

	gatt_stub_log.discover_calls++;

	if (!conn->connected) {
		return -ENOTCONN;
	}

	discover_req.conn = conn;
	discover_req.params = params;
	discover_req.active = true;

	if (gatt_stub_faults.rsp_delay_ms == 0) {
		discover_deliver();
	} else {
		(void)k_work_schedule(&discover_work, K_MSEC(gatt_stub_faults.rsp_delay_ms));
	}

	return 0;
}

/* --- Subscription ---------------------------------------------------------------- */

static void ccc_schedule(struct bt_conn *conn, struct bt_gatt_subscribe_params *params,
			 uint8_t att_err)
{
	ccc_req.conn = conn;
	ccc_req.params = params;
	ccc_req.att_err = att_err;
	ccc_req.active = true;

	if (gatt_stub_faults.defer_ccc_rsp) {
		return;
	}

	if (gatt_stub_faults.rsp_delay_ms == 0) {
		ccc_deliver();
	} else {
		(void)k_work_schedule(&ccc_work, K_MSEC(gatt_stub_faults.rsp_delay_ms));
	}
}

/* gatt_write_ccc_rsp(). */
static void ccc_deliver(void)
{
	struct bt_gatt_subscribe_params *params = ccc_req.params;
	struct bt_conn *conn = ccc_req.conn;
	uint8_t att_err = ccc_req.att_err;

	if (!ccc_req.active) {
		return;
	}

	ccc_req.active = false;
	/* gatt_write_ccc_rsp() clears this before anything else, whatever the outcome. */
	atomic_clear_bit(params->flags, BT_GATT_SUBSCRIBE_FLAG_WRITE_PENDING);

	if (att_err != 0U) {
		/* gatt_sub_find(): a connection whose subscription list is empty has no
		 * gatt_sub at all, and the response is dropped without any callback.
		 * That is the case a detach's unsubscribe leaves behind, and the only
		 * thing left that can release the transport's claim on the parameters
		 * is then the disconnect itself.
		 */
		if (sub_node == NULL || sub_conn != conn) {
			return;
		}

		if (params->subscribe != NULL) {
			params->subscribe(conn, att_err, params);
		}

		if (sub_node == params) {
			sub_node = NULL;
			params->notify(conn, params, NULL, 0);
		}

		return;
	}

	if (params->subscribe != NULL) {
		params->subscribe(conn, BT_ATT_ERR_SUCCESS, params);
	}

	if (params->value == 0U) {
		/* The write that turned notifications off has landed, so the node has
		 * finally left the host for good.
		 */
		params->notify(conn, params, NULL, 0);
	}
}

void gatt_stub_deliver_ccc_response(uint8_t att_err)
{
	ccc_req.att_err = att_err;
	ccc_deliver();
}

int bt_gatt_subscribe(struct bt_conn *conn, struct bt_gatt_subscribe_params *params)
{
	gatt_stub_log.subscribe_calls++;

	if (!conn->connected) {
		return -ENOTCONN;
	}

	if (sub_node == params) {
		/* The host reports a node that is already linked and drops its own
		 * bookkeeping, leaving the node in place.
		 */
		return -EALREADY;
	}

	if (gatt_stub_faults.subscribe_err != 0) {
		/* gatt_write_ccc() failed, so the node is never added to the list. */
		return gatt_stub_faults.subscribe_err;
	}

	sub_node = params;
	sub_conn = conn;

	if (gatt_stub_faults.subscribe_already_enabled) {
		/* gatt.c skips the write when a subscription already covers the handle,
		 * and then owes no callback at all.
		 */
		return 0;
	}

	atomic_set_bit(params->flags, BT_GATT_SUBSCRIBE_FLAG_WRITE_PENDING);
	ccc_schedule(conn, params, gatt_stub_faults.ccc_att_err);

	return 0;
}

int bt_gatt_unsubscribe(struct bt_conn *conn, struct bt_gatt_subscribe_params *params)
{
	gatt_stub_log.unsubscribe_calls++;

	if (!conn->connected) {
		return -ENOTCONN;
	}

	if (sub_node != params || sub_conn != conn) {
		return -EINVAL;
	}

	if (gatt_stub_faults.unsubscribe_err != 0) {
		/* gatt_write_ccc() failed, so the node stays in the list and no
		 * callback of any kind is owed.
		 */
		return gatt_stub_faults.unsubscribe_err;
	}

	if (ccc_req.active && ccc_req.params == params) {
		/* bt_gatt_cancel(): a descriptor write still in flight for these
		 * parameters is answered synchronously, from inside this call, with
		 * BT_ATT_ERR_UNLIKELY, before the unsubscribe goes any further.
		 */
		(void)k_work_cancel_delayable(&ccc_work);
		ccc_req.att_err = BT_ATT_ERR_UNLIKELY;
		ccc_deliver();
	}

	params->value = 0U;
	sub_node = NULL;

	if (gatt_stub_faults.subscribe_already_enabled) {
		/* No write when another subscription still covers the handle; the host
		 * reports the removal synchronously instead.
		 */
		params->notify(conn, params, NULL, 0);
		return 0;
	}

	/* The node leaves the list here, but the write it triggered is still in flight
	 * and its response is what eventually reports the removal.
	 */
	atomic_set_bit(params->flags, BT_GATT_SUBSCRIBE_FLAG_WRITE_PENDING);
	ccc_schedule(conn, params, 0U);

	return 0;
}

void gatt_stub_notify(const void *data, uint16_t len)
{
	if (sub_node != NULL) {
		(void)sub_node->notify(sub_conn, sub_node, data, len);
	}
}

/* --- Write Without Response ------------------------------------------------------ */

int bt_gatt_write_without_response_cb(struct bt_conn *conn, uint16_t handle, const void *data,
				      uint16_t length, bool sign, bt_gatt_complete_func_t func,
				      void *user_data)
{
	ARG_UNUSED(sign);

	if (!conn->connected) {
		return -ENOTCONN;
	}

	if (gatt_stub_faults.write_err != 0 &&
	    gatt_stub_log.write_calls >= gatt_stub_faults.write_err_after) {
		return gatt_stub_faults.write_err;
	}

	gatt_stub_log.write_calls++;
	gatt_stub_log.last_write_handle = handle;

	if (gatt_stub_log.frag_count < (int)ARRAY_SIZE(gatt_stub_log.frag_len)) {
		gatt_stub_log.frag_len[gatt_stub_log.frag_count] = length;
	}

	gatt_stub_log.frag_count++;

	if ((gatt_stub_log.stream_len + length) <= sizeof(gatt_stub_log.stream)) {
		memcpy(&gatt_stub_log.stream[gatt_stub_log.stream_len], data, length);
		gatt_stub_log.stream_len += length;
	}

	if (func == NULL) {
		return 0;
	}

	if (gatt_stub_faults.defer_tx_done) {
		if (tx_done_count < (int)ARRAY_SIZE(tx_done)) {
			tx_done[tx_done_count].conn = conn;
			tx_done[tx_done_count].func = func;
			tx_done[tx_done_count].user_data = user_data;
			tx_done_count++;
		}
	} else {
		func(conn, user_data);
	}

	return 0;
}

void gatt_stub_flush_tx_done(void)
{
	int count = tx_done_count;

	tx_done_count = 0;

	for (int i = 0; i < count; i++) {
		tx_done[i].func(tx_done[i].conn, tx_done[i].user_data);
	}
}

/* --- Disconnect ------------------------------------------------------------------ */

void gatt_stub_disconnect(struct bt_conn *conn)
{
	struct k_work_sync sync;

	conn->connected = false;

	/* Buffers still queued for transmission are dropped, and their completion
	 * callbacks never run.
	 */
	tx_done_count = 0;

	/*
	 * att_reset(): every pending ATT request is failed with -ECONNRESET. For a
	 * discovery that means a terminal callback with a NULL attribute, and for a
	 * descriptor write it means gatt_write_ccc_rsp() with an ATT error.
	 */
	(void)k_work_cancel_delayable_sync(&discover_work, &sync);
	(void)k_work_cancel_delayable_sync(&ccc_work, &sync);

	if (discover_req.active && discover_req.conn == conn) {
		struct bt_gatt_discover_params *params = discover_req.params;

		discover_req.active = false;
		(void)params->func(conn, NULL, params);
	}

	if (ccc_req.active && ccc_req.conn == conn) {
		gatt_stub_deliver_ccc_response(BT_ATT_ERR_UNLIKELY);
	}

	/*
	 * bt_gatt_disconnected() -> remove_subscriptions(): this transport's node is
	 * marked BT_GATT_SUBSCRIBE_FLAG_VOLATILE, so whatever is still linked is
	 * removed and reported through notify() with NULL data.
	 */
	if (sub_node != NULL && sub_conn == conn) {
		struct bt_gatt_subscribe_params *params = sub_node;

		sub_node = NULL;
		params->value = 0U;
		(void)params->notify(conn, params, NULL, 0);
	}

	/* notify_disconnected(): the application's callbacks, last of all. */
	STRUCT_SECTION_FOREACH(bt_conn_cb, cb) {
		if (cb->disconnected != NULL) {
			cb->disconnected(conn, BT_HCI_ERR_REMOTE_USER_TERM_CONN);
		}
	}
}
```

## src/gatt_stub.h
```c
/*
 * SPDX-FileCopyrightText: Copyright The Zephyr Project Contributors
 * SPDX-FileCopyrightText: Copyright (c) 2026 Jeff Welder
 *
 * SPDX-License-Identifier: Apache-2.0
 */

#ifndef ZEPHYR_TESTS_SUBSYS_MGMT_MCUMGR_TRANSPORT_BT_CLIENT_GATT_STUB_H_
#define ZEPHYR_TESTS_SUBSYS_MGMT_MCUMGR_TRANSPORT_BT_CLIENT_GATT_STUB_H_

#include <stdbool.h>
#include <stdint.h>

#include <zephyr/bluetooth/conn.h>
#include <zephyr/bluetooth/gatt.h>

/*
 * A scripted stand-in for the Bluetooth host's GATT client API, modelled on the state
 * machine in subsys/bluetooth/host/gatt.c rather than on what the unit under test happens
 * to want. See gatt_stub.c for which host behaviour each entry point reproduces.
 *
 * The real host is not compiled into this test, so these are the only definitions of the
 * GATT client entry points in the image, and no radio, controller or bt_enable() is
 * involved. What the stub can and cannot stand in for is spelled out in the test's
 * README-style comment at the top of main.c.
 */

#define GATT_STUB_MAX_FRAGS  64
#define GATT_STUB_STREAM_LEN 2048

/*
 * The connection object. The real one is opaque and owned by the host, so a test builds
 * its own and hands the address to the transport exactly as an application would hand it
 * one that came out of bt_conn_le_create().
 */
struct bt_conn {
	/* Reference count, so that a test can prove the transport balances its
	 * bt_conn_ref() and bt_conn_unref() calls on every path.
	 */
	int ref;
	bool connected;
};

/* The attribute layout the scripted peer answers discovery with. */
struct gatt_stub_peer {
	uint16_t svc_handle;
	uint16_t svc_end_handle;
	uint16_t chrc_handle;
	uint16_t value_handle;
	uint16_t ccc_handle;
	uint8_t properties;
	bool has_svc;
	bool has_chrc;
	bool has_ccc;
};

/* What the transport did, as seen from the host's side of the API. */
struct gatt_stub_log {
	int discover_calls;
	int subscribe_calls;
	int unsubscribe_calls;
	int write_calls;
	uint16_t last_write_handle;
	uint16_t frag_len[GATT_STUB_MAX_FRAGS];
	int frag_count;
	uint8_t stream[GATT_STUB_STREAM_LEN];
	uint16_t stream_len;
};

/* Everything a test can make the host do wrong. */
struct gatt_stub_faults {
	/* Returned by bt_gatt_discover() once discover_err_after calls have been
	 * accepted. The host delivers no callback at all for a request it never queued.
	 */
	int discover_err;
	int discover_err_after;
	/* Returned by bt_gatt_subscribe(); the node is not linked and no write goes out. */
	int subscribe_err;
	/* Returned by bt_gatt_unsubscribe(); the node stays linked, as in the host. */
	int unsubscribe_err;
	/* Returned by bt_gatt_write_without_response_cb() once write_err_after writes
	 * have been accepted.
	 */
	int write_err;
	int write_err_after;
	/* ATT error the client characteristic configuration write response carries. */
	uint8_t ccc_att_err;
	/* Another subscription on the connection already has notifications enabled for
	 * the handle: the host links or unlinks the node without a descriptor write, and
	 * completes an unsubscribe synchronously through notify(NULL).
	 */
	bool subscribe_already_enabled;
	/* Withhold that response until gatt_stub_deliver_ccc_response() is called. */
	bool defer_ccc_rsp;
	/* Withhold write completion callbacks until gatt_stub_flush_tx_done(). */
	bool defer_tx_done;
	/* How long the host takes to answer one leg of a discovery. Zero delivers the
	 * result from inside bt_gatt_discover(), which the real host never does.
	 */
	int rsp_delay_ms;
};

extern struct gatt_stub_peer gatt_stub_peer;
extern struct gatt_stub_log gatt_stub_log;
extern struct gatt_stub_faults gatt_stub_faults;

/* Returns the stub to a healthy peer with no faults injected. */
void gatt_stub_reset(void);

/* The ATT_MTU the stub reports for every connection. */
void gatt_stub_set_mtu(uint16_t mtu);

/* Runs the deferred client characteristic configuration write response by hand. */
void gatt_stub_deliver_ccc_response(uint8_t att_err);

/* True while a descriptor write response is still owed to the transport. */
bool gatt_stub_ccc_response_pending(void);

/* Runs withheld write completion callbacks. */
void gatt_stub_flush_tx_done(void);

/* Delivers a notification on the subscribed characteristic. */
void gatt_stub_notify(const void *data, uint16_t len);

/* The whole disconnect sequence, in the order the host runs it. */
void gatt_stub_disconnect(struct bt_conn *conn);

/* True while the transport's node is in the host's subscription list. */
bool gatt_stub_is_subscribed(void);

/* The subscription parameters the transport handed to bt_gatt_subscribe(). */
const struct bt_gatt_subscribe_params *gatt_stub_sub_params(void);

#endif /* ZEPHYR_TESTS_SUBSYS_MGMT_MCUMGR_TRANSPORT_BT_CLIENT_GATT_STUB_H_ */
```

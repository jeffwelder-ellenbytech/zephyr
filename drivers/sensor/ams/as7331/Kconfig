## drivers/sensor/ams/as7331/Kconfig
```kconfig
# Copyright (c) 2024 Jeff Welder
# SPDX-License-Identifier: Apache-2.0

# AMS AS7331 Spectral UV Sensor driver options

menuconfig AS7331
	bool "AMS AS7331 Spectral UV Sensor"
	default y
	depends on DT_HAS_AMS_AS7331_ENABLED
	select I2C
	help
	  Enable AMS AS7331 spectral UV sensor driver.

if AS7331

choice AS7331_TRIGGER_MODE
	prompt "Trigger mode"
	help
	  Specify the type of triggering to be used by the driver.

config AS7331_TRIGGER_NONE
	bool "No trigger"

config AS7331_TRIGGER_GLOBAL_THREAD
	bool "Use global thread"
	depends on GPIO
	select AS7331_TRIGGER

config AS7331_TRIGGER_OWN_THREAD
	bool "Use own thread"
	depends on GPIO
	select AS7331_TRIGGER

endchoice

config AS7331_TRIGGER
	bool

if AS7331_TRIGGER

config AS7331_THREAD_PRIORITY
	int "Thread priority"
	depends on AS7331_TRIGGER_OWN_THREAD
	default 10
	help
	  Priority of thread used by the driver to handle interrupts.

config AS7331_THREAD_STACK_SIZE
	int "Thread stack size"
	depends on AS7331_TRIGGER_OWN_THREAD
	default 1024
	help
	  Stack size of thread used by the driver to handle interrupts.

endif # AS7331_TRIGGER

endif # AS7331
```

## dts/bindings/sensor/ams,as7331.yaml
```yaml
# Copyright (c) 2024 Jeff Welder
# SPDX-License-Identifier: Apache-2.0

description: |
    AMS OSRAM AS7331 Spectral UVA/B/C Sensor With I2C Interface.
    See: https://look.ams-osram.com/m/1856fd2c69c35605/original/AS7331-Spectral-UVA-B-C-Sensor.pdf

compatible: "ams,as7331"

include: [sensor-device.yaml, i2c-device.yaml]

properties:
  ready-gpios:
    type: phandle-array
    description: |
      The READY pin of the AS7331:
      Conversion status, configurable as push pull 
      or open drain output stage (default push pull).
  sync-gpios:
    type: phandle-array
    description: |
      The SYN pin of the AS7331:
      Input for external controlled conversion.
```
